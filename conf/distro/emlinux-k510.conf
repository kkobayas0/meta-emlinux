## conf/distro/emlinux-k510.conf
```bitbake
require include/emlinux.inc

DISTRO = "emlinux-k510"
DISTRO_FEATURES_append = " kernel-510"
DISTRO_FEATURES_NATIVESDK_append = " kernel-510"

LINUX_GIT_BRANCH ?= "linux-5.10.y-cip"
LINUX_GIT_SRCREV ?= "6077b17f20b1bcfeccaa23bc05573b938c47679d"
LINUX_CVE_VERSION ??= "5.10.233"
LINUX_CIP_VERSION ?= "v5.10.233-cip56"
#
# If you want to use latest revision of the kernel, append the following line
# to local.conf
#
#LINUX_GIT_SRCREV = "${LINUX_GIT_BRANCH}"

# preferred providers and versions
require conf/distro/include/emlinux-k510-preferred-provider.inc
```

## conf/distro/emlinux.conf
```bitbake
require include/emlinux.inc

DISTRO = "emlinux"

LINUX_GIT_BRANCH ?= "linux-4.19.y-cip"
LINUX_GIT_SRCREV ?= "6e07bbcb7050f0840638c734437cc842a855dd10"
LINUX_CVE_VERSION ??= "4.19.325"
LINUX_CIP_VERSION ??= "v4.19.325-cip116"
#
# If you want to use latest revision of the kernel, append the following line
# to local.conf
#
#LINUX_GIT_SRCREV = "${LINUX_GIT_BRANCH}"

# preferred providers and versions
require conf/distro/include/emlinux-preferred-provider.inc
```
